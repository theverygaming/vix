## kernel/abi/Kconfig
```kconfig
config ENABLE_ABI_LINUX
    bool "Enable Linux ABI"
    depends on ARCH_HAS_PAGING
    default y

config ENABLE_ABI_VIX
    bool "Enable vix ABI"
    default y if ARCH_FUNNYARCH
    default n

source "abi/execfmt/Kconfig"
```

## kernel/abi/execfmt/Kconfig
```kconfig
menu "Executable formats"

config ENABLE_EXECFMT_ELF32
    bool "ELF32 Support"
    depends on ARCH_HAS_PAGING
    default y if ENABLE_ABI_LINUX || ENABLE_ABI_VIX
    default n

config ENABLE_EXECFMT_ELF64
    bool "ELF64 Support"
    depends on ARCH_HAS_PAGING
    default y if ENABLE_ABI_LINUX || ENABLE_ABI_VIX
    default n

endmenu
```

## kernel/arch/linux/Kconfig
```kconfig
config ARCH_LINUX
  bool
  default y

# stuff from arch/Kconfig

config ARCH_HAS_PAGING
  bool
  default y

config ARCH_PAGE_SIZE
  int
  default 4096

config KERNEL_HIGHER_HALF
  hex
  default 0x80000000

config HHDM_SIZE
  hex
  default 0x10000000 # 256MiB

# END stuff from arch/Kconfig

menu "Security"

config ENABLE_STACKPROTECTOR
  default y
  bool "Enable Stack Smashing Protector"

endmenu
```

## kernel/arch/xtensa/Kconfig
```kconfig
config ARCH_XTENSA
  bool
  default y

# stuff from arch/Kconfig

config ARCH_PAGE_SIZE
  int
  default 128

# END stuff from arch/Kconfig

menu "Security"

config ENABLE_STACKPROTECTOR
  default y
  bool "Enable Stack Smashing Protector"

endmenu

choice
	prompt "platform"
  default XTENSA_PLATFORM_ESP32
	config XTENSA_PLATFORM_ESP32
		bool "ESP32"
	config XTENSA_PLATFORM_ESP8266
		bool "ESP8266"
endchoice

config XTENSA_PLATFORM_NAME
  string
  default "esp32" if XTENSA_PLATFORM_ESP32
  default "esp8266" if XTENSA_PLATFORM_ESP8266

choice
	prompt "CPU variant"
  default XTENSA_VARIANT_ESP32 if XTENSA_PLATFORM_ESP32
  default XTENSA_VARIANT_D106M if XTENSA_PLATFORM_ESP8266
	config XTENSA_VARIANT_ESP32
		bool "ESP32"
    depends on XTENSA_PLATFORM_ESP32
	config XTENSA_VARIANT_D106M
		bool "Tensilica Diamond Standard 106Micro"
    depends on XTENSA_PLATFORM_ESP8266
endchoice

config XTENSA_VARIANT_NAME
	string
  default "esp32" if XTENSA_VARIANT_ESP32
  default "d106m" if XTENSA_VARIANT_D106M
```
