## kernel/Kconfig
```kconfig
mainmenu "vix/$(ARCH) $(KVERSION) Kernel Configuration"

menu "ABI's"
source "abi/Kconfig"
endmenu

source "arch/Kconfig"

menu "Drivers"
source "drivers/Kconfig"
endmenu

source "fs/Kconfig"

menu "Networking"
source "net/Kconfig"
endmenu

source "stdlibs/Kconfig"
source "tests/Kconfig"
source "kernel/Kconfig"
source "rust/Kconfig"

config ARCH
    string
    default "$(ARCH)"

config KVERSION
    string
    default "$(KVERSION)"

config MODULES
	bool "Enable loadable module support"
	modules
	default y

menu "build options"

config CXX_OPTIM_LEVEL
	prompt "G++ optimization level"
	int
	default 3
	range 0 3

endmenu

config UBSAN
    bool "Enable ubsan"
    default n
```

## kernel/arch/Kconfig
```kconfig
menu "$(ARCH)-specific"
source "arch/$(ARCH)/Kconfig"
endmenu

menu "General Arch-Specific stuff"

config ARCH_HAS_PAGING
  bool

# FIXME: this should be have 'depends on ARCH_HAS_PAGING' but currently the page size is also used as block size e.g. for the memory allocators
config ARCH_PAGE_SIZE
  int
  help
    Page size, must be a power of two

config ARCH_PAGING_LEVELS
  int
  depends on ARCH_HAS_PAGING
  help
    Maximum number of paging levels
    1 means there is at most a single page table

config KERNEL_HIGHER_HALF
  hex
  depends on ARCH_HAS_PAGING
  help
    start of higher half (virtual address)

config HHDM_PHYS_BASE
  hex
  depends on ARCH_HAS_PAGING
  default 0
  help
    start of HHDM (physical address)

config HHDM_VIRT_BASE
  hex
  depends on ARCH_HAS_PAGING
  default KERNEL_HIGHER_HALF
  help
    start of HHDM (virtual address)

config HHDM_SIZE
  hex
  depends on ARCH_HAS_PAGING
  help
    size of HHDM in bytes

endmenu
```

## kernel/arch/aarch64/Kconfig
```kconfig
config ARCH_AARCH64
  bool
  default y

# stuff from arch/Kconfig

config ARCH_PAGE_SIZE
  int
  default 4096

# END stuff from arch/Kconfig

menu "Security"

config ENABLE_STACKPROTECTOR
  default y
  bool "Enable Stack Smashing Protector"

endmenu
```

## kernel/arch/arm/Kconfig
```kconfig
config ARCH_ARM
  bool
  default y

menu "Security"

config ENABLE_STACKPROTECTOR
  default y
  bool "Enable Stack Smashing Protector"

endmenu
```

## kernel/arch/m68k/Kconfig
```kconfig
config ARCH_M68K
  bool
  default y

# stuff from arch/Kconfig

config ARCH_PAGE_SIZE
  int
  default 128

# END stuff from arch/Kconfig

menu "Security"

config ENABLE_STACKPROTECTOR
  default y
  bool "Enable Stack Smashing Protector"

endmenu

config PLAIN_BINARY
  default n
  bool "Create a plain binary instead of a macboot-compatible one"
```

## kernel/arch/x86/Kconfig
```kconfig
config ARCH_X86
  bool
  default y

# stuff from arch/Kconfig

config ARCH_HAS_PAGING
  bool
  depends on !ENABLE_KERNEL_64
  default y

config ARCH_PAGE_SIZE
  int
  default 4096

config KERNEL_HIGHER_HALF
  int
  depends on !ENABLE_KERNEL_64
  default 3221225472 # 0xC0000000

config HHDM_SIZE
  int
  depends on !ENABLE_KERNEL_64
  default 536870912 # 0x20000000 512MiB

# END stuff from arch/Kconfig

config ENABLE_KERNEL_64
  default n
  bool "64-bit kernel"

config ENABLE_KERNEL_32
  bool
  depends on !ENABLE_KERNEL_64
  default y

config ENABLE_FTRACE
  default n
  bool "Enable function tracing"

menu "Security"

config ENABLE_STACKPROTECTOR
  default y
  bool "Enable Stack Smashing Protector"

endmenu
```

## kernel/drivers/Kconfig
```kconfig
source "drivers/acpi/Kconfig"
source "drivers/pci/Kconfig"
source "drivers/net/Kconfig"
source "drivers/snd/Kconfig"

config INTREE_SAMPLE_MODULE
    tristate "In-tree sample module"
```

## kernel/drivers/acpi/Kconfig
```kconfig
config ENABLE_ACPI
    default n
    depends on ENABLE_PCI
    bool "Enable ACPI support (uACPI)"
```

## kernel/drivers/net/Kconfig
```kconfig
config ENABLE_FAKE_NETWORK_CARD
    depends on ENABLE_NETWORKING
    default y
    tristate "Enable a fake network card for testing stuff"

config ENABLE_RTL8139
    depends on ENABLE_NETWORKING
    depends on ENABLE_PCI
    default y
    tristate "RTL8139 support"
```

## kernel/drivers/pci/Kconfig
```kconfig
config ENABLE_PCI
    default y
    depends on ARCH_HAS_PCI_SUPPORT
    bool "Enable PCI support"
```

## kernel/drivers/snd/Kconfig
```kconfig
config ENABLE_AC97
    depends on ENABLE_PCI
    default n
    tristate "AC'97 support"
```

## kernel/kernel/Kconfig
```kconfig
menu "core kernel"
source "mm/Kconfig"

choice
	prompt "kernel loglevel"
	default LOGLEVEL_NORMAL
	config LOGLEVEL_INSANE
		bool "insane"
	config LOGLEVEL_DEBUG
		bool "debug"
	config LOGLEVEL_NORMAL
		bool "normal"
	config LOGLEVEL_FATAL
		bool "fatal"
	config LOGLEVEL_SILENT
		bool "silent"
endchoice

config KPRINTF_ENABLE_BUF
  	default y
  	bool "enable kprintf buffer"

config KPRINTF_BUFSIZE
	depends on KPRINTF_ENABLE_BUF
	prompt "kprintf ring buffer size"
	int
	default 16000
	range 100 1000000

config KPRINTF_LOGLEVEL
	prompt "kprintf loglevel"
	int
	default 6
	range 0 7
	help
		0 = Emergency
		1 = Alert
		2 = Critical
		3 = Error
		4 = Warning
		5 = Notice
		6 = Info
		7 = Debug

config FB_SUPPORT
  	default y
  	bool "support for framebuffers in the kernel"

config ENABLE_BUILTIN_FONT
  	depends on FB_SUPPORT
  	default y if ARCH_AARCH64
  	bool "Compile font into kernel"

config ENABLE_SYMBOL_TABLE
  	default y
  	bool "Enable symbol table"

endmenu
```

## kernel/kernel/memory_alloc/Kconfig
```kconfig
menu "memory allocator"

choice
	prompt "kmalloc allocation"
	default KMALLOC_BEST_SIZE
	config KMALLOC_FIRST_FIT
		bool "first-fit"
        help
            Will allocate the first free block found that is big enough.
            Fast but may waste memory.
	config KMALLOC_BEST_SIZE
		bool "best size"
        help
            Will search for the block that is the closest to the wanted size. 
            Allocation is slower but saves more memory.
endchoice

endmenu
```

## kernel/main/Kconfig
```kconfig
config TEST_A
	bool "Enable test B / test C"
	default y
	help
	  insert useful text here

config TEST_B
	bool "test B"
    depends on TEST_A
	help
	  test B help

config TEST_C
	bool "test C"
	depends on TEST_B
	help
	  test C help
	 
	 
config TEST_D
	bool "Enable test D"
	default n
	help
	  insert useful text here yes
```

## kernel/mm/Kconfig
```kconfig
menu "Memory Management"

config KHEAP_BUMP
    bool "Use simple bump allocator for the kernel heap"
    help
        The bump allocator is unable to free memory in literally 100% of cases (it doesnt support freeing memory).
        This means it is very inefficient in terms of memory usage.
        But due to its simplicity it is quite fast.

        Generally used for debugging, the other heap allocator is more prone to issues.
    default n

choice
	prompt "kernel heap allocation"
    depends on !KHEAP_BUMP
	default KHEAP_BEST_SIZE
	config KHEAP_FIRST_FIT
		bool "first-fit"
        help
            Will allocate the first free block found that is big enough.
            Fast but may waste memory.
	config KHEAP_BEST_SIZE
		bool "best size"
        help
            Will search for the block that is the closest to the wanted size. 
            Allocation is slower but saves more memory.
endchoice

config KFREE_CLEANUP
    bool "Enable kfree cleanup"
    depends on !KHEAP_BUMP
    help
        A cleanup frees physical memory and makes it available to the whole system again.
        Cleanups cause fragmentation which will make overall allocations slower.
    default y

config KFREE_CLEANUP_INTERVAL
	prompt "kfree cleanup interval"
    depends on KFREE_CLEANUP && !KHEAP_BUMP
	int
    default 5
	range 1 200
    help
        kfree will clean up every KFREE_CLEANUP_INTERVAL times it gets called.
        A cleanup frees physical memory.
        Bigger value -> less efficient memory usage but kfree runs faster.

config ENABLE_MEMMAP_SANITIZE
    bool "Enable Memory map Sanitization"
    default y

config MEMMAP_MAX_ENTRIES
	prompt "maximum amount of entries in memory map"
	int
	default 50
	range 1 256
        
endmenu
```

## kernel/net/Kconfig
```kconfig
config ENABLE_NETWORKING
    depends on RUST_SUPPORT
    default y
    bool "Enable networking support"
```
